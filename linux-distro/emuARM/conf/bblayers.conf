## linux-distro/emuARM/conf/bblayers.conf
```bitbake
# POKY_BBLAYERS_CONF_VERSION is increased each time build/conf/bblayers.conf
# changes incompatibly
POKY_BBLAYERS_CONF_VERSION = "2"

BBPATH = "${TOPDIR}"
BBFILES ?= ""

BBLAYERS ?= " \
  /home/erickof/Documentos/Git/CE5303-Embedded-System-for-Smart-Home/linux-distro/meta \
  /home/erickof/Documentos/Git/CE5303-Embedded-System-for-Smart-Home/linux-distro/meta-poky \
  /home/erickof/Documentos/Git/CE5303-Embedded-System-for-Smart-Home/linux-distro/meta-yocto-bsp \
  "
```

## linux-distro/meta-stargazer/conf/layer.conf
```bitbake
# We have a conf and classes directory, add to BBPATH
BBPATH .= ":${LAYERDIR}"

# We have recipes-* directories, add to BBFILES
BBFILES += "${LAYERDIR}/recipes-*/*/*.bb \
            ${LAYERDIR}/recipes-*/*/*.bbappend"

BBFILE_COLLECTIONS += "meta-stargazer"
BBFILE_PATTERN_meta-stargazer = "^${LAYERDIR}/"
BBFILE_PRIORITY_meta-stargazer = "6"

LAYERDEPENDS_meta-stargazer = "core"
LAYERSERIES_COMPAT_meta-stargazer = "dunfell"
```

## linux-distro/meta-webcam/conf/layer.conf
```bitbake
# We have a conf and classes directory, add to BBPATH
BBPATH .= ":${LAYERDIR}"

# We have recipes-* directories, add to BBFILES
BBFILES += "${LAYERDIR}/recipes-*/*/*.bb \
            ${LAYERDIR}/recipes-*/*/*.bbappend"

BBFILE_COLLECTIONS += "meta-webcam"
BBFILE_PATTERN_meta-webcam = "^${LAYERDIR}/"
BBFILE_PRIORITY_meta-webcam = "6"

LAYERDEPENDS_meta-webcam = "core"
LAYERSERIES_COMPAT_meta-webcam = "dunfell"
```

## linux-distro/rpi2/conf/bblayers.conf
```bitbake
# POKY_BBLAYERS_CONF_VERSION is increased each time build/conf/bblayers.conf
# changes incompatibly
POKY_BBLAYERS_CONF_VERSION = "2"

BBPATH = "${TOPDIR}"
BBFILES ?= ""

BBLAYERS ?= " \
  /home/kisung/poky-dunfell-23.0.2/meta \
  /home/kisung/poky-dunfell-23.0.2/meta-poky \
  /home/kisung/poky-dunfell-23.0.2/meta-yocto-bsp \
  /home/kisung/poky-dunfell-23.0.2/meta-webcam \
  /home/kisung/poky-dunfell-23.0.2/meta-raspberrypi \
  /home/kisung/poky-dunfell-23.0.2/meta-stargazer \
  /home/kisung/poky-dunfell-23.0.2/meta-oe \
  /home/kisung/poky-dunfell-23.0.2/meta-python \
  "
```
